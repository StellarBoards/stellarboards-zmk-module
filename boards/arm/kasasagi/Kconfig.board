## boards/arm/kasasagi/Kconfig.board
```kconfig
# Copyright (c) 2025 The ZMK Contributors
# SPDX-License-Identifier: MIT

config BOARD_KASASAGI
    bool "kasasagi"
    depends on SOC_NRF52840_QIAA
```

## boards/arm/kasasagi/Kconfig.defconfig
```kconfig
# Copyright (c) 2025 The ZMK Contributors
# SPDX-License-Identifier: MIT

if BOARD_KASASAGI

config ZMK_KEYBOARD_NAME
    default "Kasasagi"

if USB_DEVICE_STACK

config USB_NRFX
    default y

endif # USB_DEVICE_STACK

config BT_CTLR
    default BT

if ZMK_RGB_UNDERGLOW

config SPI
    default y

config WS2812_STRIP
    default y

endif # ZMK_RGB_UNDERGLOW

endif # BOARD_KASASAGI
```

## boards/arm/kasasagi/kasasagi_defconfig
```kconfig
# Copyright (c) 2025 The ZMK Contributors
# SPDX-License-Identifier: MIT

CONFIG_SOC_SERIES_NRF52X=y
CONFIG_SOC_NRF52840_QIAA=y
CONFIG_BOARD_KASASAGI=y

CONFIG_ZMK_USB=y
CONFIG_ZMK_BLE=y

# Keyboard IDs
CONFIG_ZMK_KEYBOARD_NAME="Kasasagi"
CONFIG_USB_DEVICE_PID=0x01f0
CONFIG_USB_DEVICE_VID=0x0256
CONFIG_USB_DEVICE_MANUFACTURER="StellarBoards"
CONFIG_USB_DEVICE_SN="SB:kasasagi-proto"

CONFIG_BT_DIS_PNP_PID=0x01f0
CONFIG_BT_DIS_PNP_VID=0x0256
CONFIG_BT_DIS_MANUF="StellarBoards"
CONFIG_BT_DIS_MODEL="Kasasagi"

CONFIG_BT_CTLR_TX_PWR_PLUS_8=y

# Work-around for Windows bug with battery notifications
CONFIG_BT_GATT_ENFORCE_SUBSCRIPTION=n

# Enable MPU
CONFIG_ARM_MPU=y

CONFIG_PINCTRL=y

# enable GPIO
CONFIG_GPIO=y

CONFIG_USE_DT_CODE_PARTITION=y
CONFIG_BUILD_OUTPUT_UF2=y

CONFIG_MPU_ALLOW_FLASH_WRITE=y
CONFIG_NVS=y
CONFIG_SETTINGS_NVS=y
CONFIG_FLASH=y
CONFIG_FLASH_PAGE_LAYOUT=y
CONFIG_FLASH_MAP=y

# Enable 32kHz crystal
CONFIG_CLOCK_CONTROL_NRF_K32SRC_XTAL=y
CONFIG_CLOCK_CONTROL_NRF_K32SRC_30PPM=y

#RGB
CONFIG_ZMK_RGB_UNDERGLOW=y
CONFIG_WS2812_STRIP=y

#RGB Advanced
CONFIG_ZMK_RGB_UNDERGLOW_EXT_POWER=y
CONFIG_ZMK_RGB_UNDERGLOW_AUTO_OFF_IDLE=y
CONFIG_ZMK_RGB_UNDERGLOW_AUTO_OFF_USB=y
CONFIG_ZMK_RGB_UNDERGLOW_ON_START=n

#Limit the maximum brightness of LEDs
CONFIG_ZMK_RGB_UNDERGLOW_BRT_MAX=50 

# Enable sleep
CONFIG_ZMK_SLEEP=y

# Enable soft off
CONFIG_ZMK_PM_SOFT_OFF=y
```

## boards/kasasagi/Kconfig.defconfig
```kconfig
# Copyright (c) 2026 StellarBoards
# SPDX-License-Identifier: MIT

if BOARD_KASASAGI

config ZMK_KEYBOARD_NAME
    default "Kasasagi"

if USB_DEVICE_STACK

config USB_NRFX
    default y

endif # USB_DEVICE_STACK

config BT_CTLR
    default BT

if ZMK_RGB_UNDERGLOW

config WS2812_STRIP
    bool
    default y
    depends on LED_STRIP

endif # ZMK_RGB_UNDERGLOW

endif # BOARD_KASASAGI
```

## boards/kasasagi/Kconfig.kasasagi
```kconfig
# Copyright (c) 2026 StellarBoards
# SPDX-License-Identifier: MIT

config BOARD_KASASAGI
    select SOC_NRF52840_QIAA
    select ZMK_BOARD_COMPAT if BOARD_KASASAGI_NRF52840_ZMK
    imply RETAINED_MEM if BOARD_KASASAGI_NRF52840_ZMK
    imply RETENTION if BOARD_KASASAGI_NRF52840_ZMK
    imply RETENTION_BOOT_MODE if BOARD_KASASAGI_NRF52840_ZMK
```

## boards/kasasagi/board.yml
```yaml
board:
  name: kasasagi
  vendor: stellarboards
  socs:
  - name: nrf52840
    variants:
    - name: zmk
```
